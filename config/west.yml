## config/west.yml
```yaml
manifest:
  remotes:
    - name: caksoylar
      url-base: https://github.com/caksoylar
  projects:
    - name: zmk
      remote: caksoylar
      revision: caksoylar/zen
      import: app/west.yml
  self:
    path: config
```
